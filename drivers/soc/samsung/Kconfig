## drivers/soc/samsung/Kconfig
```kconfig
#
# EXYNOS Soc drivers
#
menuconfig SOC_SAMSUNG
	bool "SAMSUNG SOC drivers support"

if SOC_SAMSUNG
config EXYNOS_CHIPID
	bool "Exynos Chip ID Driver Support"
	depends on ARCH_EXYNOS
	select SOC_BUS
config EXYNOS_REBOOT
	bool "Exynos Chip Reboot Driver Support"
	depends on ARCH_EXYNOS

config SAMSUNG_DMADEV
	bool
	select ARM_AMBA
	select DMADEVICES
	select PL330_DMA if (ARCH_EXYNOS7 || ARCH_EXYNOS8)
	help
	  Use DMA device engine for PL330 DMAC.

config SAMSUNG_CORE_TEST
	bool "Show system-control registers"
	depends on ARCH_EXYNOS
	help
	  Show system-control registers.

config ECT
	bool "Enable Exynos Characteristic Table File"
	default n
	depends on ARCH_EXYNOS

config ECT_OC
	bool "A5 Ultra: overclock CPU/GPU by patching the ECT top level"
	default n
	depends on ECT
	help
	  Replaces the second-highest CPU and GPU DVFS level with a new
	  overclocked top level (PLL, ASV voltage, RCC, margin, minlock and
	  thermal tables are patched consistently). Unexpected tables are left
	  untouched. Check "dmesg | grep ECT-OC" after boot.

config ECT_OC_BOOT_CAP
	bool "Boot with the OC CPU level locked (raise via scaling_max_freq)"
	depends on ECT_OC
	default y

config ECT_OC_TOP_EXTRA_UV
	int "Extra voltage for a replaced top level above Samsung's table (uV)"
	depends on ECT_OC
	default 37500

config ECT_OC_GPU_TOP_EXTRA_UV
	int "Extra voltage for the GPU top level above Samsung's table (uV)"
	depends on ECT_OC
	default 37500

config ECT_OC_THERMAL_SHIFT
	int "Delay CPU/GPU thermal throttling by this many degrees C (0 = stock)"
	depends on ECT_OC
	default 0

config ECT_OC_CPU_KHZ
	int "CPU top frequency in kHz (0 = off)"
	depends on ECT_OC
	default 2184000

config ECT_OC_CPU_UV_DELTA
	int "Extra CPU voltage over the stock top level in uV"
	depends on ECT_OC
	default 62500

config ECT_OC_CPU_UV_MAX
	int "Absolute CPU voltage cap in uV"
	depends on ECT_OC
	default 1300000

config ECT_OC_GPU_KHZ
	int "GPU top frequency in kHz (0 = off)"
	depends on ECT_OC
	default 1144000

config ECT_OC_GPU_UV_DELTA
	int "Extra GPU voltage over the stock top level in uV"
	depends on ECT_OC
	default 50000

config ECT_OC_GPU_UV_MAX
	int "Absolute GPU voltage cap in uV"
	depends on ECT_OC
	default 1100000

config ECT_OC_MIF_UNLOCK
	bool "Unlock all MIF (RAM) levels present in ECT"
	depends on ECT_OC
	default y

config ECT_OC_MIF_KHZ
	int "MIF (RAM) top level in kHz (0 = off, needs timing copy)"
	depends on ECT_OC
	default 0

config ECT_OC_MIF_UV_DELTA
	int "Extra MIF voltage in uV"
	depends on ECT_OC
	default 25000

config ECT_OC_MIF_UV_MAX
	int "Absolute MIF voltage cap in uV"
	depends on ECT_OC
	default 1050000

config ECT_DUMP
	bool "Enable Exynos Characteristic Table File Dump sysfs"
	default n
	depends on ECT

config EXYNOS_CONTENT_PATH_PROTECTION
	bool "Exynos Content Path Protection"
	default y
	help
	  Enable content path protection of EXYNOS.

config SCHED_AVG_NR_RUNNING
	bool "Enable to use average nr_running"
	default n
	help
	  Enable to use average nr_running in scheduler

config EXYNOS_HOTPLUG_GOVERNOR
	bool "Enable Exynos dynamic hotplug governor"
	select SCHED_AVG_NR_RUNNING

config EXYNOS_PM_DVS
	bool "Enable Exynos dynamic voltage setting"
	default n

config STATE_NOTIFIER
        bool "State Notifier"

endif #SOC_SAMSUNG
```

## scripts/a3ultra/Kconfig.ect_oc
```kconfig
config ECT_OC
	bool "A3 Ultra: unlock Samsung's locked CPU/GPU levels in ECT"
	depends on ECT
	default n

config ECT_OC_BOOT_CAP
	bool "Boot at the stock CPU/GPU max (raise via scaling_max_freq / gpu_max_clock)"
	depends on ECT_OC
	default y

config ECT_OC_CPU_BOOT_KHZ
	int "CPU max at boot in kHz"
	depends on ECT_OC
	default 1586000

config ECT_OC_GPU_BOOT_MHZ
	int "GPU max at boot in MHz"
	depends on ECT_OC
	default 1001

config ECT_OC_THERMAL_SHIFT
	int "Delay CPU/GPU thermal throttling by this many degrees C (0 = stock)"
	depends on ECT_OC
	default 0

config ECT_OC_CPU_KHZ
	int "CPU top frequency in kHz, must be an ECT level (0 = off)"
	depends on ECT_OC
	default 1794000

config ECT_OC_CPU_UV_DELTA
	int "Extra voltage for unlocked CPU levels in uV"
	depends on ECT_OC
	default 25000

config ECT_OC_CPU_UV_MAX
	int "Absolute CPU voltage cap in uV"
	depends on ECT_OC
	default 1250000

config ECT_OC_GPU_KHZ
	int "GPU top frequency in kHz, must be an ECT level (0 = off)"
	depends on ECT_OC
	default 1300000

config ECT_OC_GPU_UV_DELTA
	int "Extra voltage for unlocked GPU levels in uV"
	depends on ECT_OC
	default 25000

config ECT_OC_GPU_UV_MAX
	int "Absolute GPU voltage cap in uV"
	depends on ECT_OC
	default 1200000
```
